## build/poky/conf/bblayers.conf
```bitbake
LCONF_VERSION = "7"

BBLAYERS = " \
  ${TOPDIR}/../../poky/meta \
  ${TOPDIR}/../../poky/meta-poky \
  ${TOPDIR}/../../poky/meta-yocto-bsp \
  ${TOPDIR}/../../meta-openembedded/meta-oe \
  ${TOPDIR}/../../meta-swupdate \
  ${TOPDIR}/../../meta-bbb-swupdate \
  "
```

## meta-bbb-swupdate/conf/layer.conf
```bitbake
# We have a conf and classes directory, add to BBPATH
BBPATH .= ":${LAYERDIR}"

# We have recipes-* directories, add to BBFILES
BBFILES += "${LAYERDIR}/recipes-*/*/*.bb \
            ${LAYERDIR}/recipes-*/*/*.bbappend"

BBFILE_COLLECTIONS += "meta-bbb-swupdate"
BBFILE_PATTERN_meta-bbb-swupdate = "^${LAYERDIR}/"
BBFILE_PRIORITY_meta-bbb-swupdate = "6"

LAYERDEPENDS_meta-bbb-swupdate = "core"
LAYERSERIES_COMPAT_meta-bbb-swupdate = "walnascar"
```
